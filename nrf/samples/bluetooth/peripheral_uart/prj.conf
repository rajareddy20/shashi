## CMakeLists.txt
```
#
# Copyright (c) 2018 Nordic Semiconductor
#
# SPDX-License-Identifier: LicenseRef-Nordic-5-Clause
#
cmake_minimum_required(VERSION 3.20.0)

set(SHIELD nrf21540_ek)

find_package(Zephyr REQUIRED HINTS $ENV{ZEPHYR_BASE})
project(NONE)

# NORDIC SDK APP START
target_sources(app PRIVATE
  src/main.c
  src/temp_sensor.c
  src/fstorage.c
  src/led.c
  src/timers.c
)

set(HEADERS
   temp_sensor.h
   fstorage.h
   led.h
   timers.h
)

# Include UART ASYNC API adapter
target_sources_ifdef(CONFIG_BT_NUS_UART_ASYNC_ADAPTER app PRIVATE
  src/uart_async_adapter.c
)

# NORDIC SDK APP END

zephyr_library_include_directories(.)
```

## prj.conf
```kconfig
#
# Copyright (c) 2018 Nordic Semiconductor
#
# SPDX-License-Identifier: LicenseRef-Nordic-5-Clause
#

# Enable the UART driver
CONFIG_UART_ASYNC_API=y
CONFIG_NRFX_UARTE0=y
CONFIG_SERIAL=y

CONFIG_GPIO=y

CONFIG_I2C=y
CONFIG_I2C_NRFX=y
CONFIG_CBPRINTF_FP_SUPPORT=y

CONFIG_FLASH=y
CONFIG_FLASH_PAGE_LAYOUT=y
CONFIG_NVS=y
CONFIG_LOG_MODE_IMMEDIATE=y
CONFIG_NVS_LOG_LEVEL_DBG=y
CONFIG_REBOOT=y
CONFIG_MPU_ALLOW_FLASH_WRITE=y

# CONFIG_TIMER=y
# CONFIG_TIMER_1=y
# CONFIG_SYSTEM_WORKQUEUE=y


# Make sure printk is printing to the UART console
CONFIG_CONSOLE=y
CONFIG_UART_CONSOLE=y

CONFIG_HEAP_MEM_POOL_SIZE=2048

CONFIG_BT=y
CONFIG_BT_PERIPHERAL=y
CONFIG_BT_DEVICE_NAME="G8_sensor"
CONFIG_BT_DEVICE_APPEARANCE=833
CONFIG_BT_MAX_CONN=1
CONFIG_BT_MAX_PAIRED=1

# Enable the NUS service
CONFIG_BT_NUS=y

# Enable bonding
CONFIG_BT_SETTINGS=y
CONFIG_FLASH=y
CONFIG_FLASH_PAGE_LAYOUT=y
CONFIG_FLASH_MAP=y
CONFIG_NVS=y
CONFIG_SETTINGS=y

# Enable DK LED and Buttons library
CONFIG_DK_LIBRARY=y

# This example requires more workqueue stack
CONFIG_SYSTEM_WORKQUEUE_STACK_SIZE=2048

# Config logger
CONFIG_LOG=n
CONFIG_USE_SEGGER_RTT=n
CONFIG_LOG_BACKEND_RTT=n
CONFIG_LOG_BACKEND_UART=n
CONFIG_LOG_PRINTK=n

CONFIG_NEWLIB_LIBC=y
CONFIG_NFCT_PINS_AS_GPIOS=y
CONFIG_ASSERT=y
CONFIG_BT_CTLR_PHY_CODED=y


CONFIG_BT_LL_SOFTDEVICE=y
CONFIG_BT_LL_SW_SPLIT=n
CONFIG_BT_CTLR_ADVANCED_FEATURES=y
CONFIG_BT_CTLR_CONN_RSSI=y
# CONFIG_BT_CTLR_TX_PWR_DYNAMIC_CONTROL=y
# here
CONFIG_BT_CTLR_TX_PWR_ANTENNA=10
CONFIG_BT_USER_PHY_UPDATE=y

CONFIG_PM=y
CONFIG_NEWLIB_LIBC_MIN_REQUIRED_HEAP_SIZE=2048

CONFIG_MPSL_FEM=y
CONFIG_MPSL_FEM_NRF21540_GPIO=y
CONFIG_MPSL_FEM_PIN_FORWARDER=y

CONFIG_MPSL_FEM_NRF21540_TX_GAIN_DB_POUTA=10
```

## app.overlay
```dts
/*
 * Copyright (c) 2022 Nordic Semiconductor ASA
 *
 * SPDX-License-Identifier: LicenseRef-Nordic-5-Clause
 */

/ {
	chosen {
		nordic,nus-uart = &uart0;
	};
};

&nrf_radio_fem {
    // spi-if = <&nrf_radio_fem>;
    pdn-gpios = <&gpio0 10 GPIO_ACTIVE_HIGH>;     
	mode-gpios = <&gpio0 2 GPIO_ACTIVE_LOW>;     
	tx-en-gpios = <&gpio0 4 GPIO_ACTIVE_HIGH>;    
	rx-en-gpios = <&gpio0 20 GPIO_ACTIVE_HIGH>;    
};
```

## src/fstorage.c
```c
#include "fstorage.h"
#include <zephyr/device.h>
#include "temp_sensor.h"

struct nvs_fs fs;
struct samples_info latest_samples_info;


int nrf_fstorage_init(void)
{



   
    int rc = 0;

    fs.flash_device = NVS_PARTITION_DEVICE;
    if (!device_is_ready(fs.flash_device)) 
    {
        return -1;
    }

    fs.sector_size = SECTOR_SIZE;
    fs.sector_count = SECTOR_COUNT;

    fs.offset = FSTORAGE_START_ADDRESS;

    rc = nvs_mount(&fs);
    if (rc) 
    {
        return -1;
    }

    return 0;
}

void nrf_fstorage_read(struct nvs_fs *fs, long int address, struct samples_info *latest_samples_info, uint32_t size)
{
    flash_read(fs->flash_device, address, (uint8_t *)latest_samples_info, size);
}

void nrf_fstorage_write(struct nvs_fs *fs, long int address, struct samples_info *latest_samples_info, uint32_t size)
{
    flash_write(fs->flash_device, address, (uint8_t *)latest_samples_info, size);
}

void nrf_fstorage_erase(struct nvs_fs *fs, long int address, uint32_t size)
{
    flash_erase(fs->flash_device, address, (size * SECTOR_SIZE));
}

void write_samples_info_to_flash(void)
{
   uint32_t next_address = 0, next_page_address = 0;

   next_address = SAMPLES_INFO_START_ADDRESS + (0x20 * (current_sample_info_position - 1));
   
   next_page_address = SAMPLES_INFO_START_ADDRESS + 0x1000;
   
   if(next_address == next_page_address)
   {
      current_sample_info_position = 1;
      next_address = SAMPLES_INFO_START_ADDRESS;

      nrf_fstorage_erase(&fs, next_address, 1);
   }

   latest_samples_info.dirty_flag = 0xAA;
   nrf_fstorage_write(&fs, next_address, &latest_samples_info, sizeof(latest_samples_info));
   current_sample_info_position++;
}


void read_samples_info_from_flash(void)
{
   int index = 0, current_page_address = 0, next_address = 0;

   current_page_address = SAMPLES_INFO_START_ADDRESS;

   for(index = 0; index < NUMBER_OF_SAMPLES_INFO_IN_A_PAGE; index++)
   {
      next_address = current_page_address + (0x20 * index);

      nrf_fstorage_read(&fs, next_address, &latest_samples_info, sizeof(latest_samples_info));

      if(latest_samples_info.dirty_flag != 0xAA)
      {
         if(index == 0)
         {
            index = 1;
            latest_samples_info.dirty_flag = 0xAA;
            latest_samples_info.total_number_of_samples_stored = 0;
            latest_samples_info.total_number_of_samples_transmitted = 0;
            latest_samples_info.reset_counter = 0;
            current_sample_info_position = 1;

            write_samples_info_to_flash();
         }
         else
         {
            next_address = current_page_address + (0x20 * (index - 1));
            nrf_fstorage_read(&fs, next_address, &latest_samples_info, sizeof(latest_samples_info));
            current_sample_info_position = index;
         }
         break;
      }
   }
}

void read_corresponding_data_from_flash(void)
{
   uint32_t data[4] = {0};
   uint32_t read_address = 0;
   read_counter = latest_samples_info.total_number_of_samples_transmitted % MAX_NUMBER_OF_SAMPLES;
   read_address = (SAMPLES_START_ADDRESS + (16 * read_counter));

   flash_read(fs.flash_device, read_address, data, 16);
   memcpy(read_sample_data, data, 16);
}


void fstorage_write(struct nvs_fs *fs, long int address, uint8_t *data, int size)
{
   flash_write(fs->flash_device, address, data, 16);
}
```

## src/fstorage.h
```c
#include <zephyr/sys/reboot.h>
#include <zephyr/drivers/flash.h>
#include <zephyr/storage/flash_map.h>
#include <zephyr/fs/nvs.h>



#define NVS_PARTITION		storage_partition
#define NVS_PARTITION_DEVICE	FIXED_PARTITION_DEVICE(NVS_PARTITION)
#define NVS_PARTITION_OFFSET	FIXED_PARTITION_OFFSET(NVS_PARTITION)

#define SECTOR_SIZE     4096
#define SECTOR_COUNT    40


#define FSTORAGE_START_ADDRESS          0x42000 
#define FSTORAGE_END_ADDRESS            0x78000
#define SAMPLES_START_ADDRESS           0x50000
#define SAMPLE_SIZE                     16
#define MAX_NUMBER_OF_SAMPLES           9728
#define NUMBER_OF_SAMPLES_INFO_IN_A_PAGE 128
#define SAMPLES_INFO_START_ADDRESS      FSTORAGE_START_ADDRESS


extern struct nvs_fs fs;

struct samples_info
{
   int total_number_of_samples_stored;
   int total_number_of_samples_transmitted;
   int lifetime_message_counter;
   uint8_t time_set;
   int sensing_interval_in_seconds;
   uint8_t reset_counter;
   uint8_t dirty_flag;
};

extern struct samples_info latest_samples_info;

extern uint16_t current_sample_info_position;
extern uint32_t read_counter;
extern uint8_t read_sample_data[100];



int nrf_fstorage_init(void);

void nrf_fstorage_erase(struct nvs_fs *fs, long int address, uint32_t size);
void nrf_fstorage_write(struct nvs_fs *fs, long int address, struct samples_info *latest_samples_info, uint32_t size);
void nrf_fstorage_read(struct nvs_fs *fs, long int address, struct samples_info *latest_samples_info, uint32_t size);

void write_samples_info_to_flash(void);
void read_samples_info_from_flash(void);
void read_corresponding_data_from_flash(void);
void fstorage_write(struct nvs_fs *fs, long int address, uint8_t *data, int size);
```

## src/led.c
```c
#include "led.h"
#include <zephyr/kernel.h>

void leds_init(void)
{
    nrf_gpio_cfg_output(BLUE_LED);
	nrf_gpio_cfg_output(GREEN_LED);
	nrf_gpio_cfg_output(RED_LED);
}


void led_blink(uint8_t pin, uint8_t counter)
{
	uint8_t blink = 0;

	while(blink < counter)
	{
		nrf_gpio_pin_set(pin);
		k_msleep(500);
		nrf_gpio_pin_clear(pin);
		k_msleep(500);
		blink++;
	}
}

void turn_on_led(uint8_t pin)
{
    nrf_gpio_pin_set(pin);
}

void turn_off_led(uint8_t pin)
{
    nrf_gpio_pin_clear(pin);
}
```

## src/led.h
```c
#include <zephyr/device.h>
#include <zephyr/devicetree.h>
#include <dk_buttons_and_leds.h>
#include <hal/nrf_gpio.h>
#include <zephyr/drivers/gpio.h>


#define GREEN_LED 20
#define BLUE_LED 17
#define RED_LED 15

#define SLEEP_TIME_MS 1000

void leds_init(void);
void led_blink(uint8_t pin, uint8_t counter);
void turn_on_led(uint8_t pin);
void turn_off_led(uint8_t pin);
```

## src/temp_sensor.c
```c
#include "temp_sensor.h"
#include <zephyr/device.h>
#include <stdint.h>
#include <math.h>



struct device *nrfx_twis_dev1 = DEVICE_DT_GET(MY_TWIM);
int config_result = false;

uint8_t hum_tx_data[10] = {0};
uint8_t hum_rx_data[10] = {0};
unsigned int raw_temperature;

uint16_t latest_temperature = 0;
uint16_t latest_humidity = 0;
uint8_t read_buffer[10] = {0};
uint8_t valid_temperature = 1;

extern uint8_t temp_hum_data[20];

sensor_data_t sensor_data, sensor_data_to_send;

void read_temperature_and_humidity(void)
{
   float temperature;
   float humidity;
   uint16_t temp_value = 0;

   hum_tx_data[0] = 0x35;
   hum_tx_data[1] = 0x17;

   valid_temperature = i2c_write(nrfx_twis_dev1, hum_tx_data, 2, chip_address);
   k_msleep(1);

   if (valid_temperature == 0)
   {
      hum_tx_data[0] = 0x64;
      hum_tx_data[1] = 0x58;

      valid_temperature = i2c_write(nrfx_twis_dev1, hum_tx_data, 2, chip_address);
      k_msleep(10);
      
      if (valid_temperature == 0)
      {
         valid_temperature = i2c_read(nrfx_twis_dev1, hum_rx_data, 6, chip_address);
         
         if(valid_temperature == 0)
         {
            temp_value = hum_rx_data[1] | (hum_rx_data[0] << 8);
            temperature = ((float)(175 * temp_value) / (float)65536) - (float)45.00;
            temperature *= 10.0;
            // latest_temperature =  (int16_t)temperature;
            latest_temperature =  (int16_t)(temperature * 10);

            temp_value = hum_rx_data[4] | (hum_rx_data[3] << 8);
            humidity = ((float)(100 * temp_value) / 65535);                   
            latest_humidity =  (uint16_t)humidity; 

            temp_hum_data[0] = (latest_temperature & 0xFF00) >> 8;
            temp_hum_data[1] = (latest_temperature & 0x00FF);
            temp_hum_data[2] = (latest_humidity & 0x00FF);
         }
      }
   }

   if (valid_temperature != 0)
   {
      latest_temperature = 1000;;

      temp_hum_data[0] = (latest_temperature & 0xFF00) >> 8;
      temp_hum_data[1] = (latest_temperature & 0x00FF);

      temp_hum_data[2] = 0;
   }
   
   hum_tx_data[0] = 0xB0;
   hum_tx_data[1] = 0x98;

   i2c_write(nrfx_twis_dev1, hum_tx_data, 2, chip_address);

   k_msleep(5);
}

int twi_init(void)
{
   if(!device_is_ready(nrfx_twis_dev1))
	{
		return -1;  
	}

   return 0;
}
```

## src/temp_sensor.h
```c
#include <zephyr/logging/log.h>
#include <zephyr/drivers/i2c.h>
#include <zephyr/sys/util.h>

/* I2C Configurations */
#define MY_TWIM DT_NODELABEL(i2c0)
#define chip_address    0x70
#define TH_SENSOR_TYPE    5


extern struct device *nrfx_twis_dev1;
extern int config_result;

extern uint8_t hum_tx_data[10];
extern uint8_t hum_rx_data[10];
extern unsigned int raw_temperature;


typedef struct sensor_data_s
{
    uint16_t latest_humidity;
    int16_t latest_temperature;
}sensor_data_t;

extern sensor_data_t sensor_data, sensor_data_to_send;

void read_temperature_and_humidity(void);
int twi_init(void);
```

## src/timers.c
```c
#include "timers.h"
#include <zephyr/kernel.h>
#include "fstorage.h"


struct k_timer my_timer;
uint8_t start_adv_slots = 0;
uint8_t sleep_count = 0;
uint8_t start_sleep_time_ = 0;
extern uint32_t global_time;
uint32_t local_timer;
extern uint32_t temp_sensing_timer_counter;
extern uint8_t got_time_from_scanner;
extern uint8_t time_to_advertise;
uint16_t global_transmission_window;
extern uint8_t first_sample;
extern uint8_t time_to_read_temp_sensor;
extern uint8_t time_slot;

volatile  uint8_t sensor_number = 0xFF; 

void timer_handler(struct k_work *work)
{
   if(!time_update_received)
   {
      global_time++;
   }
   if(start_sleep_time_){
      sleep_count++;
   }
   if(start_adv_slots){
      local_timer++;
   }

   if((got_time_from_scanner == 0) )
   {
      if((global_time % 15) == 0)
      {
        time_to_advertise = 1;
      }
   }
   else
   {
      if((global_time % TRANSMIT_WINDOW_THRESHOLD) == 0)
      {
         global_transmission_window = 1;
         if(first_sample)
         {
            first_sample = 0;
         }
      } 

      if(((global_time % TEMP_SENSING_INTERVAL_SECONDS)== 0) && (global_transmission_window)  && (data_logging))
      {
         time_to_read_temp_sensor = 1;
         start_sleep_time_ = 1;
         sleep_count = 0;
         start_adv_slots = 0;
      } 
      
      if(sleep_count == 55){
         sleep_count = 0;
         start_sleep_time_ = 0;
         local_timer = 0;
         start_adv_slots = 1;
      }

      if(global_transmission_window && start_adv_slots)
      {         
        sensor_number = ((local_timer / TIME_SLOT_FOR_EACH_SENSOR) % MAX_SENSORS);
        if((sensor_number == time_slot) && ((global_time % TIME_SLOT_FOR_EACH_SENSOR) == 0) && (data_logging))
        {
            time_to_advertise = 1;
        }
      }
   }
}

K_WORK_DEFINE(my_work, timer_handler);

void my_timer_handler(struct k_timer *dummy)
{
    k_work_submit(&my_work);
}


void timers_init(void)
{
    k_timer_init(&my_timer, my_timer_handler, NULL);
}

void start_timer(void)
{
    k_timer_start(&my_timer,  K_MSEC(0),  K_MSEC(TIMER_INTERRUPT_DURATION));
}
```

## src/timers.h
```c
#include "led.h"

#define TIMER_INTERRUPT_DURATION    1000

extern struct k_timer my_timer;
extern uint8_t time_update_received;
extern int send_instant_packet;
extern bool data_logging;


#define TRANSMIT_WINDOW_THRESHOLD       600
#define TEMP_SENSING_INTERVAL_SECONDS   600
#define TIME_SLOT_FOR_EACH_SENSOR       5
#define MAX_SENSORS                     35

void my_work_handler(struct k_work *work);
void my_timer_handler(struct k_timer *dummy);
void timers_init(void);
void start_timer(void);
```
